/* source keypos definitions */
#include "../zmk-nodefree-config/keypos_def/keypos_42keys.h"

#define X_LT    &kp TAB
#define X_RT    &kp SEMI

#define X_LM    &kp ESC
#define X_RM    &comma_qmark 

#define X_LB    &excl_prcnt
#define X_RB    &grave_pipe

#define X_LH    &tog GRAPHITE 
#define X_RH    &tilde_hash 

/* source the main keymap */
#include "base.keymap"
